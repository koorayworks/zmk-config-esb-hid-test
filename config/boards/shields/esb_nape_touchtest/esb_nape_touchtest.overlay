#include <zephyr/dt-bindings/gpio/gpio.h>

/*
 * Nape Deck TOUCH TEST variant — layer on top of esb_nape_disptest:
 *
 *   west build ... -DSHIELD="esb_nape_rx;esb_nape_disptest;esb_nape_touchtest"
 *
 * Step 2 dedupe: the touch devicetree that v4 introduced here —
 * PAW3222 + SPI1 disabled, kscan parked on P1.03, the old i2c0
 * CST816S node disabled, the CST816T node on &xiao_i2c (i2c1,
 * 100 kHz, irq on D0 / reset on D1) and the LVGL pointer input
 * repointing — moved down into esb_nape_disptest.overlay, which is
 * now the production Deck layer. This overlay therefore defines NO
 * nodes of its own anymore; touch reaches this build through the
 * disptest layer underneath.
 *
 * What stays unique to this shield: the bring-up app in src/
 * (hardware I2C scan cross-check + tap counter / test-pattern
 * screens) and the LVGL widget extras in esb_nape_touchtest.conf
 * (LV_USE_BUTTON / LV_USE_CANVAS).
 */
