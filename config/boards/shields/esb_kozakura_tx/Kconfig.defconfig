## config/boards/shields/esb_kozakura_tx/Kconfig.shield
```kconfig
config SHIELD_ESB_KOZAKURA_TX
	def_bool $(shields_list_contains,esb_kozakura_tx)
```

## config/boards/shields/esb_nape_disptest/Kconfig.shield
```kconfig
config SHIELD_ESB_NAPE_DISPTEST
	def_bool $(shields_list_contains,esb_nape_disptest)
```

## config/boards/shields/esb_nape_patternls/Kconfig.shield
```kconfig
config SHIELD_ESB_NAPE_PATTERNLS
	def_bool $(shields_list_contains,esb_nape_patternls)
```

## config/boards/shields/esb_nape_rx/Kconfig.shield
```kconfig
config SHIELD_ESB_NAPE_RX
	def_bool $(shields_list_contains,esb_nape_rx)

config ESB_NAPE_RX_CUSTOM_FONT
	bool "Deck UI uses custom-converted Montserrat SemiBold fonts"
	depends on SHIELD_ESB_NAPE_RX
	default n
	help
	  Route the status screen's three UI sizes (16/20/28) to the
	  custom-converted Montserrat SemiBold fonts bundled in
	  src/fonts/ instead of the stock LVGL Montserrat Medium,
	  whose antialiasing smears on the Deck's ST7789V panel.
	  Enabled by the disptest and touchtest shield confs; the
	  plain receiver build leaves this off and is unchanged.
	  Reverting is a one-line conf change (the routing lives in
	  the FONT_16/FONT_20/FONT_28 macros in src/status_screen.c).

config ESB_NAPE_RX_FONT_BPP8
	bool "Deck UI custom fonts at bpp 8 instead of bpp 4"
	depends on ESB_NAPE_RX_CUSTOM_FONT
	default n
	help
	  Route the status screen's FONT_16/FONT_20/FONT_28 macros
	  (and the touchtest pattern page 2 SemiBold samples) to the
	  bpp 8 conversion of the same Montserrat SemiBold fonts
	  (sb8_* in src/fonts/, 256 alpha steps) instead of the
	  bpp 4 conversion (sb_*, 16 alpha steps). On hardware the
	  bpp 4 SemiBold smeared exactly like the stock font, so
	  alpha resolution is the remaining font-side variable.
	  Ladder: ESB_NAPE_RX_FONT_BPP1 on wins over this; then
	  this on = SemiBold bpp 8; both off + custom font on =
	  SemiBold bpp 4; custom font off = stock LVGL Montserrat
	  Medium.

config ESB_NAPE_RX_ROTATION
	bool "Deck display orientation: live rotation with settings persistence"
	depends on SHIELD_ESB_NAPE_RX
	default n
	help
	  Live 90-degree-step display rotation for the Deck UI
	  (phase 2). src/orientation.c persists the orientation
	  index in settings ("deck/orientation"), applies it at
	  boot before LVGL init (SYS_INIT APPLICATION 50), and
	  cycles it live on request from the status screen (the
	  staged panel/reframe switch proven by touchtest v11.4).
	  Requires the forked ST7789V driver from
	  zmk-feature-esb-hid (display_set_orientation). Enabled
	  by the disptest shield conf; the plain receiver build
	  leaves this off and is unchanged.

config ESB_NAPE_RX_FONT_BPP1
	bool "Deck UI custom fonts at bpp 1 instead of bpp 4/8"
	depends on ESB_NAPE_RX_CUSTOM_FONT
	default n
	help
	  Route the status screen's FONT_16/FONT_20/FONT_28 macros
	  to the bpp 1 conversion of the same Montserrat SemiBold
	  fonts (sb1_* in src/fonts/): glyph bitmaps with no
	  intermediate alpha steps at all. Partial-coverage pixels
	  come out colored on this panel (color fringes visible to
	  the naked eye), and on 2026-11-06 the user verified on
	  hardware that the bpp 1 samples render clean while the
	  bpp 4 and bpp 8 conversions smear — this is the fix, and
	  it takes priority over ESB_NAPE_RX_FONT_BPP8 in the
	  FONT_* macro ladder in src/status_screen.c. Ladder:
	  this on = SemiBold bpp 1; this off + BPP8 on = SemiBold
	  bpp 8; both off + custom font on = SemiBold bpp 4;
	  custom font off = stock LVGL Montserrat Medium.
```

## config/boards/shields/esb_nape_touchtest/Kconfig.shield
```kconfig
config SHIELD_ESB_NAPE_TOUCHTEST
	def_bool $(shields_list_contains,esb_nape_touchtest)
```

## config/boards/shields/esb_nickey_tx/Kconfig.defconfig
```kconfig
if SHIELD_ESB_NICKEY_TX

config ZMK_KEYBOARD_NAME
	default "ESB Nickey TX"

endif
```

## config/boards/shields/esb_tentalice_tx/Kconfig.defconfig
```kconfig
if SHIELD_ESB_TENTALICE_TX

config ZMK_KEYBOARD_NAME
	default "ESB Tentalice TX"

endif
```

## config/boards/shields/esb_tentalice_tx/Kconfig.shield
```kconfig
config SHIELD_ESB_TENTALICE_TX
	def_bool $(shields_list_contains,esb_tentalice_tx)
```

## config/west.yml
```yaml
manifest:
  remotes:
    - name: koorayworks
      url-base: https://github.com/koorayworks
  projects:
    - name: zmk
      remote: koorayworks
      revision: esb-hid
      import: app/west.yml
    - name: zmk-feature-esb-hid
      remote: koorayworks
      revision: feat/studio-over-esb
    - name: zmk-driver-paw3222
      remote: koorayworks
      revision: zmk-0.4
  self:
    path: config
```
